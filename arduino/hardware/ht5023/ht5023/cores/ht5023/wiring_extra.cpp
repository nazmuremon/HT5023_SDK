// wiring_extra.cpp -- the corners of the Arduino API that libraries reach for.
//
// pulseIn, tone/noTone and dtostrf are not usually the point of a sketch, but
// enough libraries call them that leaving them out turns into a link error in
// somebody else's code. All three are bit-banged from the CPU: the part's
// timers are not wired into this core yet, so tone() blocks for its duration
// and pulseIn() busy-waits.
#include <stdio.h>

#include "Arduino.h"

// Rough cost of one iteration of the wait loops below, used to turn the
// caller's microsecond timeout into a loop count. The core runs at the same
// rate SysTick counts, which is not F_CPU. Measured against micros() at
// -Os; being a little off only affects the timeout, never the returned width,
// which is timed with micros().
#define PULSE_LOOPS_PER_US ((unsigned long)(HT5023_SYSTICK_HZ / 1000000UL) / 3UL + 1UL)

static unsigned long wait_for_state(uint8_t pin, uint8_t state,
                                    unsigned long loops) {
  while (digitalRead(pin) != (int)state) {
    if (loops-- == 0u) return 0u;
  }
  return 1u;
}

unsigned long pulseIn(uint8_t pin, uint8_t state, unsigned long timeout) {
  const unsigned long loops = timeout * PULSE_LOOPS_PER_US;

  // Wait out any pulse already in progress, then for the edge that starts ours.
  if (!wait_for_state(pin, (uint8_t)!state, loops)) return 0u;
  if (!wait_for_state(pin, state, loops)) return 0u;

  const unsigned long start = micros();
  if (!wait_for_state(pin, (uint8_t)!state, loops)) return 0u;
  return micros() - start;
}

unsigned long pulseInLong(uint8_t pin, uint8_t state, unsigned long timeout) {
  return pulseIn(pin, state, timeout);
}

// tone() is generated by toggling the pin in a delay loop, so it occupies the
// CPU while it plays. A call without a duration would never return, so it is
// treated as a short beep instead of hanging the sketch.
#define TONE_DEFAULT_MS 100UL

static uint8_t g_tone_pin = 0xFFu;

void tone(uint8_t pin, unsigned int frequency, unsigned long duration) {
  if (frequency == 0u) {
    noTone(pin);
    return;
  }

  const unsigned long half_period_us = 500000UL / frequency;
  if (half_period_us == 0u) return;

  const unsigned long ms = duration ? duration : TONE_DEFAULT_MS;
  const unsigned long cycles = (ms * 1000UL) / (half_period_us * 2UL);

  g_tone_pin = pin;
  pinMode(pin, OUTPUT);
  for (unsigned long i = 0; i < cycles; ++i) {
    digitalWrite(pin, HIGH);
    delayMicroseconds((unsigned int)half_period_us);
    digitalWrite(pin, LOW);
    delayMicroseconds((unsigned int)half_period_us);
  }
  g_tone_pin = 0xFFu;
}

void noTone(uint8_t pin) {
  if (pin == g_tone_pin || g_tone_pin == 0xFFu) {
    digitalWrite(pin, LOW);
    g_tone_pin = 0xFFu;
  }
}

// AVR's non-standard float formatter. Libraries use it because sprintf("%f")
// is a no-op on that part; here it is just a wrapper, kept for source
// compatibility.
extern "C" char* dtostrf(double value, signed char width, unsigned char prec,
                         char* s) {
  char fmt[16];
  snprintf(fmt, sizeof(fmt), "%%%d.%uf", (int)width, (unsigned)prec);
  snprintf(s, 32u, fmt, value);
  return s;
}

// newlib declares itoa/utoa but not the long forms, and Arduino code uses all
// four. Same contract: writes into `s`, returns it.
extern "C" char* ultoa(unsigned long value, char* s, int base) {
  if (base < 2 || base > 36) base = 10;
  char tmp[33];
  int i = 0;
  do {
    const unsigned long digit = value % (unsigned long)base;
    tmp[i++] = (char)(digit < 10u ? ('0' + digit) : ('a' + digit - 10u));
    value /= (unsigned long)base;
  } while (value != 0u);

  char* out = s;
  while (i > 0) *out++ = tmp[--i];
  *out = 0;
  return s;
}

extern "C" char* ltoa(long value, char* s, int base) {
  if (base == 10 && value < 0) {
    s[0] = '-';
    ultoa((unsigned long)(-value), s + 1, base);
    return s;
  }
  return ultoa((unsigned long)value, s, base);
}
